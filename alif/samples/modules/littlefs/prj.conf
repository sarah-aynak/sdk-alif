## CMakeLists.txt
```
# Required minimum CMake version
cmake_minimum_required(VERSION 3.20.0)

# Find Zephyr (uses $ZEPHYR_BASE from your environment)
find_package(Zephyr REQUIRED HINTS $ENV{ZEPHYR_BASE})

# Name of your project
project(my_littlefs_project)

# Add your application source files
target_sources(app PRIVATE src/main.c)
```

## prj.conf
```kconfig
CONFIG_HAS_ALIF_SE_SERVICES=y
CONFIG_MRAM_FLASH_ALIF=y
CONFIG_BOOT_BANNER=y
CONFIG_ARM_MPU=y
CONFIG_LOG=y
CONFIG_LOG_MODE_MINIMAL=y

CONFIG_FLASH=y
CONFIG_FLASH_MAP=y

CONFIG_FILE_SYSTEM=y
CONFIG_FILE_SYSTEM_MKFS=y
CONFIG_FILE_SYSTEM_LITTLEFS=y
```

## boards/alif_e7_dk_rtss_he.overlay
```dts
/ {
    fstab {
        compatible = "zephyr,fstab";

        lfs0: lfs0 {
            compatible = "zephyr,fstab,littlefs";
            read-size = <32>;
            prog-size = <32>;
            cache-size = <256>;
            lookahead-size = <64>;
            block-cycles = <512>;
            partition = <&storage_partition>;
            mount-point = "/lfs";
        };
    };
};

&storage_partition {
    reg = <0x00040000 0x00300000>; /* 3 MB */
    label = "storage";
    status = "okay";
};
```

## src/main.c
```c
#include <zephyr/kernel.h>
#include <zephyr/storage/flash_map.h>
#include <zephyr/logging/log.h>

LOG_MODULE_REGISTER(test, LOG_LEVEL_INF);

void main(void)
{
    const struct flash_area *pfa;
    int rc = flash_area_open(FIXED_PARTITION_ID(storage_partition), &pfa);
    if (rc < 0) {
        LOG_ERR("flash_area_open failed: %d", rc);
        return;
    }

    LOG_INF("Partition @0x%x size=%u on %s",
            (unsigned)pfa->fa_off,
            (unsigned)pfa->fa_size,
            pfa->fa_dev->name);

    /* Try erase one block (0x400 bytes) */
    //rc = flash_area_erase(pfa, 0, 0x400);
    //LOG_INF("erase rc=%d", rc);

    /* Try write 16 bytes */
    uint8_t tmp[16];
    for (int i = 0; i < sizeof(tmp); i++) {
        tmp[i] = 0xA5 + i;
    }
    rc = flash_area_write(pfa, 0, tmp, sizeof(tmp));
    LOG_INF("write rc=%d", rc);

    /* Close the flash area */
    flash_area_close(pfa);
}
```
