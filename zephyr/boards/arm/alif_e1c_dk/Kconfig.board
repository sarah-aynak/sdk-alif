## zephyr/boards/arm/alif_e1c_dk/Kconfig.board
```kconfig
# Copyright (c) 2024 Alif Semiconductor
#
# SPDX-License-Identifier: Apache-2.0

config ALIF_E1C_DK_BOARD
	bool "Alif Devkit Ensemble E1C Dev board"
	depends on SOC_SERIES_ENSEMBLE_E1C
```

## zephyr/boards/arm/alif_e1c_dk/Kconfig.defconfig
```kconfig
# Copyright (c) 2024 Alif Semiconductor
#
# SPDX-License-Identifier: Apache-2.0

if ALIF_E1C_DK_BOARD

config BOARD
	default "alif_e1c_devkit"

endif # ALIF_E1C_DK_BOARD
```

## zephyr/boards/arm/alif_e3_dk/Kconfig.defconfig
```kconfig
# Copyright (c) 2024 Alif Semiconductor
#
# SPDX-License-Identifier: Apache-2.0

if ALIF_E3_DK_BOARD

config BOARD
	default "alif_e3_devkit"

endif # ALIF_E3_DEVKIT
```

## zephyr/boards/arm/alif_e7_dk/Kconfig.board
```kconfig
# Copyright (c) 2024 Alif Semiconductor
#
# SPDX-License-Identifier: Apache-2.0

config ALIF_E7_DK_BOARD
	bool "Alif Devkit Ensemble E7 Dev board"
	depends on SOC_SERIES_ENSEMBLE_E7
```

## zephyr/boards/arm/alif_e7_dk/Kconfig.defconfig
```kconfig
# Copyright (c) 2024 Alif Semiconductor
#
# SPDX-License-Identifier: Apache-2.0

if ALIF_E7_DK_BOARD

config BOARD
	default "alif_e7_devkit"

endif # ALIF_E7_DK_BOARD
```

## zephyr/drivers/comparator/Kconfig
```kconfig
menuconfig CMP
	bool "Comparator(cmp) drivers"
	# All platforms that implement the CMP driver are now required to
	# provide relevant DTS entries.
	help
	  Enable cmp driver configuration.

if CMP
config CMP_INIT_PRIORITY
	int "CMP init priority"
	default 50
	help
	  CMP driver device initialization priority.

module = CMP
module-str = CMP
source "subsys/logging/Kconfig.template.log_config"

source "drivers/comparator/Kconfig.alif"

endif
```

## zephyr/drivers/video/Kconfig.alif
```kconfig
# Alif Camera controller driver configuration options

# Copyright (C) 2024 Alif Semiconductor
# SPDX-License-Identifier: Apache-2.0

config VIDEO_ALIF_CAM
	bool "Camera Parallel Interface (CPI) controller driver"
	default y
	depends on DT_HAS_ALIF_CAM_ENABLED

if VIDEO_ALIF_CAM

module = VIDEO
module-str = video
source "subsys/logging/Kconfig.template.log_config"

config VIDEO_ALIF_CAM_INIT_PRIORITY
	int "CPI Video initialization priority"
	default 61
	help
	 System initialization priority for Alif Camera Driver.

config FB_USES_DTCM_REGION
	bool "CPI uses DTCM region for buffers"

endif #VIDEO_ALIF_CAM
```

## zephyr/dts/bindings/audio/alif,alifpcm.yaml
```yaml
# Copyright (c) 2024 Alif Semiconductor
#
# SPDX-License-Identifier: Apache-2.0

description: Alif Semiconductor PDM module

compatible: "alif,alifpcm"

include: pinctrl-device.yaml

properties:
  reg:
    type: array
    required: true

  interrupts:
    type: array
    required: true
```

## zephyr/dts/bindings/cpu/arm,cortex-m55.yaml
```yaml
# Copyright (c) 2024 Alif Semiconductor
# SPDX-License-Identifier: Apache-2.0

description: ARM Cortex-M55 CPU

compatible: "arm,cortex-m55"

include: arm,cortex-m.yaml
```

## zephyr/dts/bindings/flash_controller/alif,mram-flash-controller.yaml
```yaml
# Copyright (c) 2024 Alif Semiconductor
#
# SPDX-License-Identifier: Apache-2.0
description: Alif SoC MRAM flash controller

compatible: "alif,mram-flash-controller"

include: flash-controller.yaml
```

## zephyr/dts/bindings/timer/alif,utimer.yaml
```yaml
# Copyright (c) 2024 Alif Semiconductor
#
# SPDX-License-Identifier: Apache-2.0

description: Alif Universal Timer

compatible: "alif,utimer"

include: [base.yaml]

properties:
  reg:
    required: true

  reg-names:
    required: true

  clock-frequency:
    type: int
    required: true
    description: |
      Input clock frequency for timer

  timer-id:
    type: int
    description: |
      Channel number for each channel

  counter-direction:
    type: int
    required: true
    description: |
      Sets timer counter direction.

      Use constants defined in dt-bindings/timer/alif-utimer.h.

      * ALIF_UTIMER_COUNTER_DIRECTION_UP           - used as up counter.
      * ALIF_UTIMER_COUNTER_DIRECTION_DOWN         - used as down counter.
      * ALIF_UTIMER_COUNTER_DIRECTION_TRIANGLE     - used as triangle counter.

  driver-enable:
    type: int
    required: true
    description: |
      Set driver type to enable output.

      Use constants defined in dt-bindings/timer/alif-utimer.h.

      * ALIF_UTIMER_DRIVER_A_OUTPUT_ENABLE         - to enable driver A output.
      * ALIF_UTIMER_DRIVER_B_OUTPUT_ENABLE         - to enable driver B output.
      * (ALIF_UTIMER_DRIVER_A_OUTPUT_ENABLE|ALIF_UTIMER_DRIVER_B_OUTPUT_ENABLE)
                                                       - to enable both drivers.
```

## zephyr/soc/arm/alif_balletto/Kconfig
```kconfig
# Copyright (c) 2024 Alif Semiconductor
#
# SPDX-License-Identifier: Apache-2.0

config SOC_FAMILY_BALLETTO
	bool "Alif Balletto family of SoC"
	select HAS_SEGGER_RTT

if SOC_FAMILY_BALLETTO

config SOC_FAMILY
	string
	default "alif_balletto"

source "soc/arm/alif_balletto/*/Kconfig.soc"
endif # SOC_FAMILY_BALLETTO
```

## zephyr/soc/arm/alif_balletto/b1/Kconfig.defconfig.b1_fpga_rtss_he
```kconfig
# Copyright (c) 2024 Alif Semiconductor
#
# SPDX-License-Identifier: Apache-2.0

if SOC_B1_FPGA_RTSS_HE

config SOC
	default "Balletto"

config NUM_IRQS
	default 480

config SYS_CLOCK_HW_CYCLES_PER_SEC
	default 24000000

endif # SOC_B1_FPGA_RTSS_HE
```

## zephyr/soc/arm/alif_balletto/b1/Kconfig.defconfig.series
```kconfig
# Copyright (c) 2024 Alif Semiconductor
#
# SPDX-License-Identifier: Apache-2.0

if SOC_SERIES_BALLETTO_B1

config SOC_SERIES
	default "b1"

config ROM_START_OFFSET
	default 0x800 if BOOTLOADER_MCUBOOT

source "soc/arm/alif_balletto/b1/Kconfig.defconfig.b*"

endif # SOC_SERIES_BALLETTO_B1
```

## zephyr/soc/arm/alif_ensemble/Kconfig.soc
```kconfig
# Copyright (c) 2024 Alif Semiconductor
#
# SPDX-License-Identifier: Apache-2.0

source "soc/arm/alif_ensemble/*/Kconfig.series"
```

## zephyr/soc/arm/alif_ensemble/e1c/Kconfig.defconfig.series
```kconfig
# Copyright (c) 2024 Alif Semiconductor
#
# SPDX-License-Identifier: Apache-2.0

if SOC_SERIES_ENSEMBLE_E1C

config SOC_SERIES
	default "e1c"

source "soc/arm/alif_ensemble/e1c/Kconfig.defconfig.e*"

endif # SOC_SERIES_ENSEMBLE_E1C
```

## zephyr/soc/arm/alif_ensemble/e3/Kconfig.defconfig.e3_dk_rtss_he
```kconfig
# Copyright (c) 2024 Alif Semiconductor
#
# SPDX-License-Identifier: Apache-2.0

if SOC_E3_DK_RTSS_HE

config SOC
	default "ensemble"

config NUM_IRQS
	default 480

config SYS_CLOCK_HW_CYCLES_PER_SEC
	default 160000000

endif # SOC_E3_RTSS_HE
```

## zephyr/soc/arm/alif_ensemble/e3/Kconfig.defconfig.series
```kconfig
# Copyright (c) 2024 Alif Semiconductor
#
# SPDX-License-Identifier: Apache-2.0

if SOC_SERIES_ENSEMBLE_E3

config SOC_SERIES
	default "e3"

source "soc/arm/alif_ensemble/e3/Kconfig.defconfig.e*"

endif # SOC_SERIES_ENSEMBLE_E3
```

## zephyr/soc/arm/alif_ensemble/e7/Kconfig.defconfig.e7_dk_rtss_hp
```kconfig
# Copyright (c) 2024 Alif Semiconductor
#
# SPDX-License-Identifier: Apache-2.0

if SOC_E7_DK_RTSS_HP

config SOC
	default "ensemble"

config NUM_IRQS
	default 480

config SYS_CLOCK_HW_CYCLES_PER_SEC
	default 400000000

endif # SOC_E7_RTSS_HP
```

## zephyr/soc/arm/alif_ensemble/e7/Kconfig.defconfig.series
```kconfig
# Copyright (c) 2024 Alif Semiconductor
#
# SPDX-License-Identifier: Apache-2.0

if SOC_SERIES_ENSEMBLE_E7

config SOC_SERIES
	default "e7"

source "soc/arm/alif_ensemble/e7/Kconfig.defconfig.e*"

endif # SOC_SERIES_ENSEMBLE_E7
```
