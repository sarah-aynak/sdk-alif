/*
 * Copyright (c) 2024 Alif Semiconductor.
 * SPDX-License-Identifier: Apache-2.0
 */

/*
 * I2S_0 => Speaker Output
 * I2S_2 => Mic Input
 */

i2s_tx: &i2s0 {
	status = "okay";
};

i2s_rx: &i2s2 {
	status = "okay";
};

