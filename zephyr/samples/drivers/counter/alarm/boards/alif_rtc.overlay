/* Copyright (c) 2024 Alif Semiconductor
 *
 * SPDX-License-Identifier: Apache-2.0
 */

/*
 * Enabling rtc & disabling lptimer for this sample application
 */

&timer0 {
	status = "disabled";
};

&rtc0 {
	status = "okay";
};
